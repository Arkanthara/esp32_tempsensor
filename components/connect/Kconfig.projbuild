## components/connect/Kconfig.projbuild
```kconfig
menu "Network Configuration"

	config TIME_TO_WAIT
		int "Time to wait before having tryed to connect to all networks of the list (in ms)"
		default 5000

	config WAIT_TIME
		int "Wait time in ms for connection"
		default 20000

	config SCAN_MAX
		int "Max number of network in a scan"
		default 5

	config MAC_ADDR_SIZE
	       int "MAC address size"
	       default 6
endmenu
```

## components/http/Kconfig.projbuild
```kconfig
menu "URL for HTTP Post"

config URL
	string "URL to post datas to server"
	default "https://zelittlemichelserver.azurewebsites.net/api/Esp"
endmenu
```

## components/networkstorage/Kconfig.projbuild
```kconfig
menu "Network SSID & PASSWORD"
       	config NETWORK_0_SSID
		string "Network SSID"
		default "WIFI_Mobile"
	config NETWORK_0_PWD
		string "Network Password"
		default "428fdcf3d44d5e92a54d1ca5579d21416be03291895184d724abf652f24a"

	config NETWORK_1_SSID
		string "Network SSID"
	config NETWORK_1_PWD
		string "Network Password"

	config NETWORK_2_SSID
		string "Network SSID"
	config NETWORK_2_PWD
		string "Network Password"

	config NETWORK_3_SSID
		string "Network SSID"
	config NETWORK_3_PWD
		string "Network Password"

	config NETWORK_4_SSID
		string "Network SSID"
	config NETWORK_4_PWD
		string "Network Password"

	config NETWORK_5_SSID
		string "Network SSID"
	config NETWORK_5_PWD
		string "Network Password"

	config NETWORK_6_SSID
		string "Network SSID"
	config NETWORK_6_PWD
		string "Network Password"

	config NETWORK_7_SSID
		string "Network SSID"
	config NETWORK_7_PWD
		string "Network Password"

	config NETWORK_8_SSID
		string "Network SSID"
	config NETWORK_8_PWD
		string "Network Password"

	config NETWORK_9_SSID
		string "Network SSID"
	config NETWORK_9_PWD
		string "Network Password"
endmenu
```

## main/Kconfig.projbuild
```kconfig
menu "Config sensor"

	config WAIT_TIME_SEND
	int "Time (in ms) to wait before sending new datas"
	default 5000

endmenu
```
